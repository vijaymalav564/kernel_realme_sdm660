/* Copyright (c) 2017, The Linux Foundation. All rights reserved.
 *
 * This program is free software; you can redistribute it and/or modify
 * it under the terms of the GNU General Public License version 2 and
 * only version 2 as published by the Free Software Foundation.
 *
 * This program is distributed in the hope that it will be useful,
 * but WITHOUT ANY WARRANTY; without even the implied warranty of
 * MERCHANTABILITY or FITNESS FOR A PARTICULAR PURPOSE.  See the
 * GNU General Public License for more details.
 */

&mdss_mdp {
	dsi_oppo18316dpt_jdi_nt36672a_1080_2340_video: qcom,mdss_dsi_oppo18316dpt_jdi_nt36672a_1080_2340_video {
		qcom,cont-splash-enabled;
		qcom,mdss-dsi-panel-name = "oppo18321dpt nt36672a 1080 2340 video mode dsi panel";
		qcom,mdss-dsi-panel-manufacture = "DPT4096";
		qcom,mdss-dsi-panel-version = "NT36672A";
		qcom,mdss-dsi-panel-controller = <&mdss_dsi0>;
		qcom,mdss-dsi-panel-destination = "display_1";
		qcom,mdss-dsi-panel-type = "dsi_video_mode";
		qcom,mdss-dsi-panel-framerate = <60>;
		qcom,mdss-dsi-virtual-channel-id = <0>;
		qcom,mdss-dsi-stream = <0>;
		qcom,mdss-dsi-panel-width = <1080>;
		qcom,mdss-dsi-panel-height = <2340>;
		qcom,mdss-dsi-h-front-porch = <76>;
		qcom,mdss-dsi-h-back-porch = <80>;
		qcom,mdss-dsi-h-pulse-width = <48>;
		qcom,mdss-dsi-h-sync-skew = <0>;
		qcom,mdss-dsi-v-back-porch = <24>;
		qcom,mdss-dsi-v-front-porch = <24>;
		qcom,mdss-dsi-v-pulse-width = <2>;
		qcom,mdss-dsi-h-left-border = <0>;
		qcom,mdss-dsi-h-right-border = <0>;
		qcom,mdss-dsi-v-top-border = <0>;
		qcom,mdss-dsi-v-bottom-border = <0>;
		qcom,mdss-dsi-bpp = <24>;
		qcom,mdss-dsi-underflow-color = <0xff>;
		qcom,mdss-dsi-border-color = <0>;
		qcom,mdss-dsi-h-sync-pulse = <0>;
		qcom,mdss-dsi-traffic-mode = "burst_mode";
		qcom,mdss-dsi-bllp-eof-power-mode;
		qcom,mdss-dsi-bllp-power-mode;
		qcom,mdss-dsi-lane-0-state;
		qcom,mdss-dsi-lane-1-state;
		qcom,mdss-dsi-lane-2-state;
		qcom,mdss-dsi-lane-3-state;
		qcom,mdss-dsi-panel-timings = [e6 38 26 00 68 6e 2a
				3c 44 03 04 00];
		qcom,mdss-dsi-t-clk-post = <0x0d>;
		qcom,mdss-dsi-t-clk-pre = <0x2f>;
		qcom,mdss-dsi-bl-min-level = <1>;
		qcom,mdss-brightness-max-level = <4095>;
		qcom,mdss-dsi-bl-max-level = <4095>;
		qcom,mdss-dsi-dma-trigger = "trigger_sw";
		qcom,mdss-dsi-mdp-trigger = "none";
		qcom,mdss-dsi-on-command = [
				15 01 00 00 00 00 02 FF 23
				15 01 00 00 00 00 02 FB 01
				15 01 00 00 00 00 02 05 24
				15 01 00 00 00 00 02 07 20
				15 01 00 00 00 00 02 08 04
				15 01 00 00 00 00 02 11 01
				15 01 00 00 00 00 02 12 8A
				15 01 00 00 00 00 02 15 6A
				15 01 00 00 00 00 02 16 0B
				15 01 00 00 00 00 02 45 FC
				15 01 00 00 00 00 02 46 F9
				15 01 00 00 00 00 02 47 F6
				15 01 00 00 00 00 02 48 F3
				15 01 00 00 00 00 02 49 F0
				15 01 00 00 00 00 02 4A ED
				15 01 00 00 00 00 02 4B EA
				15 01 00 00 00 00 02 4C E7
				15 01 00 00 00 00 02 4D E4
				15 01 00 00 00 00 02 4E E1
				15 01 00 00 00 00 02 4F DE
				15 01 00 00 00 00 02 50 DB
				15 01 00 00 00 00 02 51 D8
				15 01 00 00 00 00 02 52 D5
				15 01 00 00 00 00 02 53 D2
				15 01 00 00 00 00 02 54 CF
				15 01 00 00 00 00 02 FF 10
				15 01 00 00 00 00 02 FB 01
				29 01 00 00 00 00 06 3B 03 0A 0A 04 04
				15 01 00 00 0A 00 02 11 00
				15 01 00 00 00 00 02 51 FF
				15 01 00 00 00 00 02 53 24
				15 01 00 00 00 00 02 55 02
				15 01 00 00 00 00 02 35 00
				15 01 00 00 78 00 02 29 00];
		qcom,mdss-dsi-off-command = [
				05 01 00 00 14 00 02 28 00
				05 01 00 00 78 00 02 10 00];
		qcom,mdss-dsi-on-command-state = "dsi_lp_mode";
		qcom,mdss-dsi-off-command-state = "dsi_lp_mode";
		qcom,mdss-dsi-lp11-init;
		qcom,mdss-dsi-init-delay-us = <5000>;
		qcom,mdss-dsi-bl-pmic-control-type = "bl_ctrl_wled";
		qcom,mdss-dsi-reset-sequence = <1 10>, <0 10>, <1 10>;
		qcom,mdss-dsi-tx-eot-append;
		qcom,mdss-dsi-post-init-delay = <1>;
		qcom,esd-check-enabled;
		qcom,mdss-dsi-panel-status-check-mode = "reg_read";
		qcom,mdss-dsi-panel-status-command = [06 01 00 01 00 00 01 0A];
		qcom,mdss-dsi-panel-status-command-state = "dsi_hs_mode";
		qcom,mdss-dsi-panel-status-value = <0x9c>;
		qcom,mdss-dsi-panel-on-check-value = <0x9c>;
		qcom,mdss-dsi-panel-status-read-length = <1>;
		qcom,mdss-dsi-panel-max-error-count = <3>;
		qcom,mdss-dsi-cabc-off-command = [
				15 01 00 00 00 00 02 53 2C
				15 01 00 00 00 00 02 55 00
				05 01 00 00 10 00 02 29 00];
		qcom,mdss-dsi-cabc-ui-command = [
				15 00 00 00 00 00 02 FF 24
				15 00 00 00 00 00 02 FB 01
				15 00 00 00 00 00 02 C2 87
				15 00 00 00 00 00 02 FF 23
				15 00 00 00 00 00 02 FB 01
				15 00 00 00 00 00 02 45 FC
				15 00 00 00 00 00 02 46 F9
				15 00 00 00 00 00 02 47 F6
				15 00 00 00 00 00 02 48 F3
				15 00 00 00 00 00 02 49 F0
				15 00 00 00 00 00 02 4A ED
				15 00 00 00 00 00 02 4B EA
				15 00 00 00 00 00 02 4C E7
				15 00 00 00 00 00 02 4D E4
				15 00 00 00 00 00 02 4E E1
				15 00 00 00 00 00 02 4F DE
				15 00 00 00 00 00 02 50 DB
				15 00 00 00 00 00 02 51 D8
				15 00 00 00 00 00 02 52 D5
				15 00 00 00 00 00 02 53 D2
				15 00 00 00 00 00 02 54 CF
				15 00 00 00 00 00 02 45 FC
				15 00 00 00 00 00 02 46 F9
				15 00 00 00 00 00 02 FF 10
				15 00 00 00 00 00 02 53 2C
				15 01 00 00 00 00 02 55 01
				05 01 00 00 10 00 02 29 00];
		qcom,mdss-dsi-cabc-still-image-command = [
				15 00 00 00 00 00 02 FF 24
				15 00 00 00 00 00 02 FB 01
				15 00 00 00 00 00 02 C2 87
				15 00 00 00 00 00 02 FF 23
				15 00 00 00 00 00 02 FB 01
				15 00 00 00 00 00 02 45 E2
				15 00 00 00 00 00 02 46 DF
				15 00 00 00 00 00 02 47 DC
				15 00 00 00 00 00 02 48 D9
				15 00 00 00 00 00 02 49 D6
				15 00 00 00 00 00 02 4A D3
				15 00 00 00 00 00 02 4B CD
				15 00 00 00 00 00 02 4C C8
				15 00 00 00 00 00 02 4D C2
				15 00 00 00 00 00 02 4E BD
				15 00 00 00 00 00 02 4F B7
				15 00 00 00 00 00 02 50 B2
				15 00 00 00 00 00 02 51 AC
				15 00 00 00 00 00 02 52 A7
				15 00 00 00 00 00 02 53 A1
				15 00 00 00 00 00 02 54 9C
				15 00 00 00 00 00 02 45 E2
				15 00 00 00 00 00 02 46 DF
				15 00 00 00 00 00 02 FF 10
				15 00 00 00 00 00 02 53 2C
				15 01 00 00 00 00 02 55 02
				05 01 00 00 10 00 02 29 00];
		qcom,mdss-dsi-cabc-video-command = [
				15 00 00 00 00 00 02 FF 24
				15 00 00 00 00 00 02 FB 01
				15 00 00 00 00 00 02 C2 87
				15 00 00 00 00 00 02 FF 23
				15 00 00 00 00 00 02 FB 01
				15 00 00 00 00 00 02 45 D8
				15 00 00 00 00 00 02 46 D5
				15 00 00 00 00 00 02 47 D2
				15 00 00 00 00 00 02 48 CF
				15 00 00 00 00 00 02 49 C9
				15 00 00 00 00 00 02 4A C4
				15 00 00 00 00 00 02 4B BC
				15 00 00 00 00 00 02 4C B3
				15 00 00 00 00 00 02 4D AB
				15 00 00 00 00 00 02 4E A3
				15 00 00 00 00 00 02 4F 9B
				15 00 00 00 00 00 02 50 93
				15 00 00 00 00 00 02 51 8B
				15 00 00 00 00 00 02 52 85
				15 00 00 00 00 00 02 53 7D
				15 00 00 00 00 00 02 54 75
				15 00 00 00 00 00 02 45 D8
				15 00 00 00 00 00 02 46 D5
				15 00 00 00 00 00 02 FF 10
				15 00 00 00 00 00 02 53 2C
				15 01 00 00 00 00 02 55 03
				05 01 00 00 10 00 02 29 00];
		qcom,mdss-dsi-pan-enable-dynamic-fps;
		qcom,mdss-dsi-pan-fps-update = "dfps_immediate_porch_mode_vfp";
		qcom,mdss-dsi-min-refresh-rate = <45>;
		qcom,mdss-dsi-max-refresh-rate = <60>;
		qcom,mdss-pan-physical-width-dimension = <67>;
		qcom,mdss-pan-physical-height-dimension = <145>;
	};
};
