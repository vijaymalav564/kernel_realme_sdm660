/* Copyright (c) 2016-2017, The Linux Foundation. All rights reserved.
 *
 * This program is free software; you can redistribute it and/or modify
 * it under the terms of the GNU General Public License version 2 and
 * only version 2 as published by the Free Software Foundation.
 *
 * This program is distributed in the hope that it will be useful,
 * but WITHOUT ANY WARRANTY; without even the implied warranty of
 * MERCHANTABILITY or FITNESS FOR A PARTICULAR PURPOSE.  See the
 * GNU General Public License for more details.
 */

//#ifndef CONFIG_PRODUCT_REALME_RMX1801
/* Disable WLED */
//&pm660l_wled {
//	status = "disabled";
//};
//#else
//Shengjun.Gou@PSW.MM.Display.LCD.Stability, 2018/05/24,
// change for enable wled
/* Enable WLED */
&pm660l_wled {
	status = "ok";
};
//#endif

/* disable LCDB */
&pm660l_lcdb {
	status = "disabled";
};

&pm660a_oledb {
	status = "disabled";
};

&pm660a_labibb {
	status = "disabled";
};
