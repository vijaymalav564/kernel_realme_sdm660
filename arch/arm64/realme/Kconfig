## arch/arm64/realme/Kconfig
```kconfig
menu "Realme product selection"

config PRODUCT_REALME
	bool "Realme devices"
	help
	  This enables support for Realme devices.

if PRODUCT_REALME

config PRODUCT_REALME_SDM660
	bool "Realme SDM660-Common"

choice
	prompt "Realme device"

config PRODUCT_REALME_RMX1801
	bool "Realme 2 Pro"
	select PRODUCT_REALME_SDM660
	help
	  This enables support for Realme 2 Pro.

endchoice

endif

endmenu
```

## drivers/input/touchscreen/oppo_touchscreen/Novatek/Kconfig
```kconfig
source "drivers/input/touchscreen/oppo_touchscreen/Novatek/NT36672_noflash/Kconfig"
```

## drivers/soc/oppo/oppo_devinfo/Kconfig
```kconfig
# ifdef CONFIG_PRODUCT_REALME_RMX1801 
# yixue.ge add for config oppo software devinfo soft
      config OPPO_DEVICE_IFNO
      bool "config oppo devinfo software"
	  help
		define this config to compile devinfo.c for device register
#endif /* CONFIG_PRODUCT_REALME_RMX1801 */
```

## drivers/soc/oppo/oppo_project/Kconfig
```kconfig
# ifdef CONFIG_PRODUCT_REALME_RMX1801 
# yixue.ge add for config oppo software common soft
      config OPPO_COMMON_SOFT
      bool "config oppo common software"
	  help
		define this config to get project verion from sharemem.
		Maybe this value is from CDT or dynamic identify by hardware
		id.
#endif /* CONFIG_PRODUCT_REALME_RMX1801 */
```

## drivers/staging/ksu/Kconfig
```kconfig
menu "KernelSU"

config KSU
	tristate "KernelSU function support"
	select OVERLAY_FS
	default n
	help
	Enable kernel-level root privileges on Android System.

config KSU_DEBUG
	bool "KernelSU debug mode"
	depends on KSU
	default n
	help
	Enable KernelSU debug mode

config KSU_NO_KPROBES
	tristate "KernelSU flags without kprobes"
	default n
	depends on KSU
	help
	Needed for legacy kernel with broken kprobes with patch applied.
	Read more at https://kernelsu.org/guide/how-to-integrate-for-non-gki.html#manully-modify-the-kernel-source

endmenu
```
